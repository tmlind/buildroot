## configs/droid4_kexecboot_defconfig
```kconfig
BR2_arm=y
BR2_cortex_a9=y
BR2_ARM_ENABLE_NEON=y
BR2_ARM_ENABLE_VFP=y
BR2_ARM_INSTRUCTIONS_THUMB2=y
BR2_TOOLCHAIN_BUILDROOT_MUSL=y
BR2_TARGET_GENERIC_HOSTNAME="droid4"
BR2_TARGET_GENERIC_PASSWD_SHA512=y
BR2_ROOTFS_DEVICE_CREATION_DYNAMIC_MDEV=y
BR2_TARGET_GENERIC_GETTY_PORT="ttyO2"
BR2_TARGET_GENERIC_GETTY_BAUDRATE_115200=y
# BR2_TARGET_GENERIC_REMOUNT_ROOTFS_RW is not set
BR2_SYSTEM_DHCP="wlan0"
BR2_ROOTFS_OVERLAY="board/motorola/droid4/rootfs_overlay"
BR2_ROOTFS_POST_BUILD_SCRIPT="board/motorola/droid4/post-build.sh"
BR2_PACKAGE_BUSYBOX_WATCHDOG=y
BR2_PACKAGE_BUSYBOX_WATCHDOG_PERIOD="10"
BR2_PACKAGE_KEXEC=y
BR2_PACKAGE_KEXEC_ZLIB=y
BR2_PACKAGE_KEXEC_DROID4=y
BR2_PACKAGE_KEXECBOOT=y
BR2_PACKAGE_E2FSPROGS=y
# BR2_PACKAGE_E2FSPROGS_FSCK is not set
BR2_PACKAGE_DROID4_MODULES=y
BR2_PACKAGE_AUTOSSH=y
BR2_PACKAGE_DROPBEAR=y
BR2_PACKAGE_IW=y
BR2_PACKAGE_WPA_SUPPLICANT=y
BR2_PACKAGE_WPA_SUPPLICANT_AUTOSCAN=y
BR2_PACKAGE_WPA_SUPPLICANT_PASSPHRASE=y
BR2_TARGET_ROOTFS_TAR_XZ=y
```

## package/droid4-modules/Config.in
```kconfig
config BR2_PACKAGE_DROID4_MODULES
	bool "Droid 4 stock kernel modules"
	depends on BR2_ROOTFS_POST_BUILD_SCRIPT = "board/motorola/droid4/post-build.sh"
	help
	  Download and install uart and kexec modules for Droid 4
	  legacy stock kernel. These modules need to be built using
	  gcc-4.8 against a hacked up v3.18 kernel tree and are
	  currently not built from source in buildroot to avoid
	  limiting the be buildroot rootfs to an old compiler.
```

## package/kexec-droid4/Config.in
```kconfig
config BR2_PACKAGE_KEXEC_DROID4
	bool "Droid 4 legacy kexec"
	depends on BR2_PACKAGE_KEXEC && BR2_PACKAGE_DROID4_MODULES
	help
	  Download and install legacy kexec binary for droid 4.
	  This is needed to boot legacy v3.18 based kernels that
	  can't be done with the mainline kexec binary as the
	  droid 4 legacy kexec binary is still using atags.
```

## package/kexecboot/Config.in
```kconfig
config BR2_PACKAGE_KEXECBOOT
	bool "kexecboot"
	depends on BR2_PACKAGE_KEXEC
	help
	  Kexecboot is a GUI for kexec that can be used on
	  kernels without CONFIG_VT

	  https://github.com/kexecboot/kexecboot
```

## package/runbattd/Config.in
```kconfig
config BR2_PACKAGE_RUNBATTD
	bool "runbattd"
	depends on BR2_PACKAGE_KEXEC_DROID4
	help
	  Runbattd is an application to start the stock Android battery
	  charger app battd on Motorola Mapphone devices

	  https://github.com/runbattd/runbattd
```
